## examples/esp-idf/ota/main/Kconfig.projbuild
```kconfig
menu "Handbook OTA"
config EXAMPLE_WIFI_SSID
    string "Wi-Fi SSID"
    default ""
config EXAMPLE_WIFI_PASSWORD
    string "Wi-Fi password (stored in local sdkconfig)"
    default ""
config EXAMPLE_OTA_URL
    string "HTTPS firmware URL"
    default ""
config EXAMPLE_SNTP_SERVER
    string "SNTP server"
    default "pool.ntp.org"
config EXAMPLE_FORCE_SELFTEST_FAIL
    bool "Fail self-test to demonstrate rollback"
    default n
endmenu
```

## examples/esp-idf/ota/sdkconfig.defaults
```kconfig
CONFIG_IDF_TARGET="esp32"
CONFIG_ESPTOOLPY_FLASHSIZE_4MB=y
CONFIG_PARTITION_TABLE_CUSTOM=y
CONFIG_PARTITION_TABLE_CUSTOM_FILENAME="partitions.csv"
CONFIG_BOOTLOADER_APP_ROLLBACK_ENABLE=y
CONFIG_MBEDTLS_CERTIFICATE_BUNDLE=y
```
